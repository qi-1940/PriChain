## drivers/Kconfig
```kconfig
# 在最后追加以下代码

menu "RB Lock/Semaphore Support"
	depends on MODULES

source "drivers/codes/rb_mutex/Kconfig"

source "drivers/codes/rb_rwmutex/Kconfig"

source "drivers/codes/rb_rwsem/Kconfig"

endmenu
```
